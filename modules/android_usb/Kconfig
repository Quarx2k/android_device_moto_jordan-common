## modules/android_usb/Kconfig
```kconfig
config ANDROID_USB_ICS
        tristate "Defy: android_usb sysfs class wrapper"
        default m
```

## modules/backports/Kconfig
```kconfig
mainmenu "Linux Backports from $BACKPORTED_KERNEL_NAME $BACKPORTED_KERNEL_VERSION (with backports $BACKPORTS_VERSION)"

config BACKPORTS_VERSION
	string
	option env="BACKPORTS_VERSION"
config BACKPORTED_KERNEL_VERSION
	string
	option env="BACKPORTED_KERNEL_VERSION"
config BACKPORTED_KERNEL_NAME
	string
	option env="BACKPORTED_KERNEL_NAME"

# these will be generated
source Kconfig.kernel
source Kconfig.versions

# some hacks ...
config WIRELESS
	def_bool y
config NET_CORE
	def_bool y
config EXPERT
	def_bool y

# this has the configuration for the backport code
source compat/Kconfig

# these are copied from the kernel
source net/wireless/Kconfig
source net/mac80211/Kconfig
source net/bluetooth/Kconfig
source drivers/net/wireless/Kconfig
source drivers/net/ethernet/Kconfig
source drivers/net/usb/Kconfig

source drivers/ssb/Kconfig
source drivers/bcma/Kconfig

source net/nfc/Kconfig

source drivers/regulator/Kconfig
source drivers/media/Kconfig

source net/ieee802154/Kconfig
source net/mac802154/Kconfig
source drivers/net/ieee802154/Kconfig

source drivers/usb/class/Kconfig
```

## modules/backports/compat/Kconfig
```kconfig
#
# backport Kconfig
#
# Some options are user-selectable ("BACKPORT_USERSEL_*")
#
# Most options, however, follow a few different schemes:
#
# A) An option that is selected by drivers ("select FOO") will be
#    changed to "select BACKPORT_FOO" (if the option BACKPORT_FOO
#    exists). The option BACKPORT_FOO then controls setting of the
#    BACKPORT_BUILD_FOO option, which is a module, like this:
#
# config BACKPORT_BUILD_FOO
#	tristate
#	# or bool
#
#	# not possible on kernel < X.Y, build will fail if any
#	# drivers are allowed to build on kernels < X.Y
#	depends on BACKPORT_KERNEL_X_Y
#
#	# don't build the backport code if FOO is in the kernel
#	# already, but only if the kernel version is also >= X.Z;
#	# this is an example of backporting where the version of
#	# the FOO subsystem that we need is only available from
#	# kernel version X.Z
#	depends on !FOO || BACKPORT_KERNEL_X_Z
#
#	# build if driver needs it (it selects BACKPORT_FOO)
#	default m if BACKPORT_FOO
#
#	# or for build-testing (BACKPORT_USERSEL_BUILD_ALL is enabled)
#	default m if BACKPORT_USERSEL_BUILD_ALL
#
# config BACKPORT_FOO
#	bool
#
# This only works as-is if the kernel code is usable on any version,
# otherwise the "&& !FOO" part needs to be different.
#
#
# B) An option for code always present on some kernels (e.g. KFIFO).
#    This simply depends on/sets the default based on the version:
#
# config BACKPORT_BUILD_KFIFO
#	def_bool y
#	depends on BACKPORT_KERNEL_2_6_36
#
#
# C) similarly, a kconfig symbol for an option, e.g.
#    BACKPORT_OPTION_BT_SOCK_CREATE_NEEDS_KERN (see below)
#
#
# Variations are obviously possible.
#

#config BACKPORT_BUILD_FW_LOADER
#	tristate
#	depends on m
#	# RHEL6, starting from 6.0, backports the FW loader already
#	depends on !BACKPORT_RHEL_KERNEL_6_0
#	depends on !FW_LOADER || BACKPORT_KERNEL_2_6_33
#	default m if BACKPORT_FW_LOADER
#	default m if BACKPORT_USERSEL_BUILD_ALL
#
#config BACKPORT_FW_LOADER
#	bool

config BACKPORT_USERSEL_NET_SCH_CODEL
	tristate "codel"
	depends on m
	depends on m
	depends on !BACKPORT_KERNEL_2_6_25
	default m if NET_SCH_CODEL=n
	default m if BACKPORT_USERSEL_BUILD_ALL

config BACKPORT_USERSEL_NET_SCH_FQ_CODEL
	tristate "FQ codel"
	depends on m
	depends on m
	depends on !BACKPORT_KERNEL_2_6_25
	default m if NET_SCH_FQ_CODEL=n
	default m if BACKPORT_USERSEL_BUILD_ALL

config BACKPORT_BUILD_KFIFO
	def_bool y
	# RHEL6, starting from 6.1, backports kfifo already
	depends on !BACKPORT_RHEL_KERNEL_6_1
	depends on BACKPORT_KERNEL_2_6_36

config BACKPORT_BUILD_CORDIC
	tristate
	depends on m
	depends on !CORDIC
	default m if BACKPORT_CORDIC
	default m if BACKPORT_USERSEL_BUILD_ALL

config BACKPORT_CORDIC
	bool

config BACKPORT_BUILD_CRC8
	tristate
	depends on m
	depends on !CRC8
	default m if BACKPORT_CRC8
	default m if BACKPORT_USERSEL_BUILD_ALL

config BACKPORT_CRC8
	bool

config BACKPORT_BUILD_GENERIC_ATOMIC64
	bool
	default y if !64BIT && !GENERIC_ATOMIC64

config BACKPORT_OPTION_BT_SOCK_CREATE_NEEDS_KERN
	bool
	# in RHEL6 (starting from 6.0), the function needs the argument
	default y if !BACKPORT_KERNEL_2_6_33 || BACKPORT_RHEL_KERNEL_6_0

config BACKPORT_BUILD_AVERAGE
	bool
	depends on !AVERAGE
	default y if BACKPORT_USERSEL_BUILD_ALL
	default y if BACKPORT_AVERAGE
	#h-file linux/average.h
	#c-file lib/average.c

config BACKPORT_AVERAGE
	bool

config BACKPORT_OPTION_USB_URB_THREAD_FIX
	bool
	default y if BACKPORT_KERNEL_2_6_36

config BACKPORT_MII
	bool

config BACKPORT_BUILD_DMA_SHARED_BUFFER
	bool
	depends on ANON_INODES
	depends on !BACKPORT_KERNEL_3_0
	depends on !DMA_SHARED_BUFFER || BACKPORT_KERNEL_3_5
	default y if BACKPORT_DMA_SHARED_BUFFER
	default y if BACKPORT_USERSEL_BUILD_ALL
	#h-file linux/dma-buf.h
	#c-file drivers/base/dma-buf.c

config BACKPORT_DMA_SHARED_BUFFER
	bool

config BACKPORT_BUILD_DMA_SHARED_HELPERS
	bool
	depends on HAS_DMA
	# Build on other kernels kernels < 3.9 if HAVE_GENERIC_DMA_COHERENT is
	# not set. Kernels >= 3.8 have this if HAS_DMA is set.
	depends on (!HAVE_GENERIC_DMA_COHERENT || BACKPORT_KERNEL_3_9)
	# Always build if on 3.3 - 3.5
	default y if (BACKPORT_KERNEL_3_4 || BACKPORT_KERNEL_3_5 || BACKPORT_KERNEL_3_6)
	# build for testing
	default y if BACKPORT_USERSEL_BUILD_ALL

config BACKPORT_BUILD_LEDS
	bool
	depends on !NEW_LEDS || !LEDS_CLASS || !LEDS_TRIGGERS
	default y if BACKPORT_NEW_LEDS
	default y if BACKPORT_LEDS_CLASS
	default y if BACKPORT_LEDS_TRIGGERS

config BACKPORT_NEW_LEDS
	bool

config BACKPORT_LEDS_CLASS
	bool

config BACKPORT_LEDS_TRIGGERS
	bool

config BACKPORT_USERSEL_BUILD_ALL
	bool "Build all compat code"
	help
	  This option selects all the compat code options
	  that would otherwise only be selected by drivers.

	  It's only really useful for compat testing, so
	  you probably shouldn't enable it.
```

## modules/backports/drivers/net/wireless/mwifiex/Kconfig
```kconfig
config MWIFIEX
	depends on !BACKPORT_KERNEL_2_6_27
	tristate "Marvell WiFi-Ex Driver"
	depends on m
	depends on CFG80211
	---help---
	  This adds support for wireless adapters based on Marvell
	  802.11n/ac chipsets.

	  If you choose to build it as a module, it will be called
	  mwifiex.

config MWIFIEX_SDIO
	tristate "Marvell WiFi-Ex Driver for SD8786/SD8787/SD8797/SD8897"
	depends on m
	depends on MWIFIEX && MMC
	select BACKPORT_FW_LOADER
	---help---
	  This adds support for wireless adapters based on Marvell
	  8786/8787/8797 chipsets with SDIO interface.

	  If you choose to build it as a module, it will be called
	  mwifiex_sdio.

config MWIFIEX_PCIE
	tristate "Marvell WiFi-Ex Driver for PCIE 8766/8897"
	depends on m
	depends on MWIFIEX && PCI
	select BACKPORT_FW_LOADER
	---help---
	  This adds support for wireless adapters based on Marvell
	  8766/8897 chipsets with PCIe interface.

	  If you choose to build it as a module, it will be called
	  mwifiex_pcie.

config MWIFIEX_USB
	tristate "Marvell WiFi-Ex Driver for USB8797"
	depends on m
	depends on MWIFIEX && USB
	select BACKPORT_FW_LOADER
	---help---
	  This adds support for wireless adapters based on Marvell
	  Avastar 88W8797 chipset with USB interface.

	  If you choose to build it as a module, it will be called
	  mwifiex_usb.
```

## modules/backports/drivers/net/wireless/ti/wl1251/Kconfig
```kconfig
menuconfig WL1251
	depends on !BACKPORT_KERNEL_3_0
	tristate "TI wl1251 driver support"
	depends on m
	depends on MAC80211
	select BACKPORT_FW_LOADER
	depends on CRC7
	---help---
	  This will enable TI wl1251 driver support. The drivers make
	  use of the mac80211 stack.

	  If you choose to build a module, it'll be called wl1251. Say
	  N if unsure.

config WL1251_SPI
	depends on !BACKPORT_KERNEL_2_6_37
	tristate "TI wl1251 SPI support"
	depends on m
	depends on WL1251 && SPI_MASTER
	---help---
	  This module adds support for the SPI interface of adapters using
	  TI wl1251 chipset.  Select this if your platform is using
	  the SPI bus.

	  If you choose to build a module, it'll be called wl1251_spi.
	  Say N if unsure.

config WL1251_SDIO
	depends on !BACKPORT_KERNEL_2_6_37
	tristate "TI wl1251 SDIO support"
	depends on m
	depends on WL1251 && MMC
	---help---
	  This module adds support for the SDIO interface of adapters using
	  TI wl1251 chipset.  Select this if your platform is using
	  the SDIO bus.

	  If you choose to build a module, it'll be called
	  wl1251_sdio. Say N if unsure.
```

## modules/backports/net/bluetooth/hidp/Kconfig
```kconfig
config BT_HIDP
	depends on !BACKPORT_KERNEL_2_6_28
	depends on !BACKPORT_KERNEL_2_6_33
	tristate "HIDP protocol support"
	depends on m
	depends on BT && INPUT
	depends on HID
	help
	  HIDP (Human Interface Device Protocol) is a transport layer
	  for HID reports.  HIDP is required for the Bluetooth Human
	  Interface Device Profile.

	  Say Y here to compile HIDP support into the kernel or say M to
	  compile it as module (hidp).
```

## modules/clockfix/Kconfig
```kconfig
config DEFYPLUS_CLOCKFIX
        tristate "Defy Plus: Fix warning in clocks"
        default m
        depends on SYMSEARCH
```

## modules/pvr/Kconfig
```kconfig
config SGX540
	tristate "PowerVR SGX"
	depends on ARCH_OMAP4
	---help---
	  Support for the PowerVR SGX 3D core.

config SGX530
	tristate "PowerVR SGX"
	depends on ARCH_OMAP3
	---help---
	  Support for the PowerVR SGX 3D core.

config VIRTUAL_DISPLAY_SUPPORT
	tristate "Virtual display support"
	depends on SGX540
	---help---
	  Support for showing one framebuffer split in 2 displays at the same
	  time. Each display will show a part of the framebuffer by updating
	  the corresponding overlay on each display. This feature requires
	  2 framebuffers so CONFIG_FB_OMAP2_NUM_FBS must be 2 and each
	  framebuffer must be initialized correctly.
	  The current implementation supports only panels of the same X and Y
	  resolutions and both panels must have the same bits per pixel values.
	  This feature is EXPERIMENTAL and might not be stable if power
	  management is added at the moment.
	  It is important to give enough memory to FB0 to allow at least
	  one buffer with twice the height of a normal single display buffer,
	  so if the panel needs 864x480x4 bytes for one single display buffer
	  you must give twice the size which is 864x960x4 with the bootargs
	  omapfb.vram='0:4M'. To enable double buffering you need to give
	  864x960x4x2 bytes for two buffers, the bootargs should have
	  omapfb.vram='0:8M'. Since FB1 must also be initialized properly be
	  sure to left enough memory for one single buffer (864x480x4 bytes).
	  The bootarg 'vram' must have the FB0 and FB1 memory requirements
	  combined. Example:
	  If you want FB0 with 4M (no double buffering) and FB1 with 2M, the
	  bootargs must have the following:
	  vram='6M' omapfb.vram='0:4M,1:2M'

choice
	prompt "SGX revision"
	depends on SGX530
	default SGX_REV125

config SGX_REV121
       bool "Revision 1.2.1 - Omap 3430"

config SGX_REV125
	bool "Revision 1.2.5 - Omap 3630"

endchoice

choice
	prompt "SGX revision"
	depends on SGX540
	default SGX_REV120

config SGX_REV110
       bool "Revision 1.1.0 - Omap 4430 ES1"

config SGX_REV120
       bool "Revision 1.2.0 - Omap 4430 ES2"

endchoice

choice
	prompt "PowerVR build type"
	depends on SGX530
	default SGX_530_BUILD_RELEASE

config SGX_530_BUILD_RELEASE
       bool "SGX530 RELEASE"

config SGX_530_BUILD_DEBUG
       bool "SGX530 DEBUG"

endchoice

choice
	prompt "PowerVR build type"
	depends on SGX540
	default SGX_540_BUILD_RELEASE

config SGX_540_BUILD_RELEASE
       bool "SGX540 RELEASE"

config SGX_540_BUILD_DEBUG
       bool "SGX540 DEBUG"

endchoice

config SGX_DEBUG_DISPLAY_DRIVER
       depends on SGX530 || SGX540
       bool "Enable Debug Messages in the 3rd Party Display Driver"

config SGX_PDUMP
	depends on SGX530 || SGX540
	bool "PowerVR SGX Parameter Dump"
	---help---
	  This option enables the PDump (Parameter Dump) build to debug
	  the SGX driver. The user side of the driver must be built with
	  this option enabled as well
```

## modules/sources/camera_misc/Kconfig
```kconfig
#
# Copyright (C) 2009 Motorola, Inc.
#               2011 CyanogenDefy
#
# This program is free software; you can redistribute it and/or modify
# it under the terms of the GNU General Public License version 2 as
# published by the Free Software Foundation.
#
# This program is distributed in the hope that it will be useful,
# but WITHOUT ANY WARRANTY; without even the implied warranty of
# MERCHANTABILITY or FITNESS FOR A PARTICULAR PURPOSE.  See the
# GNU General Public License for more details.
#
# You should have received a copy of the GNU General Public License
# along with this program; if not, write to the Free Software
# Foundation, Inc., 59 Temple Place, Suite 330, Boston, MA
# 02111-1307, USA
#
# Motorola 2009-Feb-18 - Initial Creation
#

config VIDEO_CAM_ISE
	tristate "Motorola Camera ISE Interface"
	depends on I2C && VIDEO_V4L2
	default m
	---help---
	  This is a Video4Linux2 isp and vl42 configuration handler for
	  the motorola ISE driver, which resides in the user space.
	  For first Defy (Green Lens) model

config CAMERA_MISC
	tristate "Motorola Camera Driver"
	select VIDEO_CAM_ISE
	depends on SYMSEARCH
	default m
```
